## config/boards/shields/dp1000/Kconfig.defconfig
```kconfig
# Copyright (c) 2020 The ZMK Contributors
# SPDX-License-Identifier: MIT

if SHIELD_dp1000_LEFT

config ZMK_KEYBOARD_NAME
	default "dp1000"

config ZMK_SPLIT_ROLE_CENTRAL
	default y

endif

if SHIELD_dp1000_LEFT || SHIELD_dp1000_RIGHT

config ZMK_SPLIT
	default y

config ZMK_DISPLAY
    select LV_USE_CONT
    select LV_FONT_MONTSERRAT_26
    select LV_FONT_MONTSERRAT_16
    select LV_USE_LABEL
    select LV_USE_IMG

choice ZMK_DISPLAY_STATUS_SCREEN
    default ZMK_DISPLAY_STATUS_SCREEN_CUSTOM
endchoice

if ZMK_DISPLAY

config SPI
    default y

config IL0323
    default y

config ZMK_DISPLAY_BLANK_ON_IDLE
    default n

endif # ZMK_DISPLAY

endif
```

## config/boards/shields/dp1000/Kconfig.shield
```kconfig
# Copyright (c) 2022 The ZMK Contributors
# SPDX-License-Identifier: MIT

config SHIELD_dp1000_LEFT
	def_bool $(shields_list_contains,dp1000_left)
	select SPI

config SHIELD_dp1000_RIGHT
	def_bool $(shields_list_contains,dp1000_right)
	select SPI
```
